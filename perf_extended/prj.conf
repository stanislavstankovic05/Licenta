## CMakeLists.txt
```
cmake_minimum_required(VERSION 3.20)
find_package(Zephyr REQUIRED HINTS $ENV{ZEPHYR_BASE})
project(perf_demo)

set(VMMU_DIR ${CMAKE_CURRENT_SOURCE_DIR}/../vmmu)

option(PERF_VMMU "Build with VMMU instrumentation" OFF)
option(PERF_NO_TLB "Disable the TLB fast path (naive measurement)" OFF)
option(PERF_NO_HOIST "Use the no-hoist pass variant (per-element checks)" OFF)

# Both pass variants share the same PipelineStart+mem2reg registration and
# differ only in loop range hoisting — a clean A/B for the hoisting effect.
if(PERF_NO_HOIST)
    set(PASS_SO ${CMAKE_CURRENT_SOURCE_DIR}/../passes/build/libVMMUPassNoHoist.so)
else()
    set(PASS_SO ${CMAKE_CURRENT_SOURCE_DIR}/../passes/build/libVMMUPassO0.so)
endif()

# ----------------------------------------------------------------
# Common sources (always compiled with GCC)
# ----------------------------------------------------------------
target_sources(app PRIVATE src/main.c)
target_include_directories(app PRIVATE src)

# ----------------------------------------------------------------
# VMMU build
# ----------------------------------------------------------------
if(PERF_VMMU)
    message(STATUS "[perf_demo] VMMU build — VMMUPass + shadow memory")

    target_sources(app PRIVATE
        src/vmmu_glue.c
        ${VMMU_DIR}/vmmu.c
        ${VMMU_DIR}/translator.c
        ${VMMU_DIR}/frame/frame.c
        ${VMMU_DIR}/virtual_space/addrspace.c
        ${VMMU_DIR}/virtual_space/vpage.c
        ${VMMU_DIR}/heap/heap.c
        ${VMMU_DIR}/app/app.c
        ${VMMU_DIR}/tlb.c
        ${VMMU_DIR}/libc_wrap.c
        ${VMMU_DIR}/pass_defaults.c
    )

    target_include_directories(app PRIVATE
        ${VMMU_DIR}
        ${VMMU_DIR}/frame
        ${VMMU_DIR}/virtual_space
        ${VMMU_DIR}/heap
        ${VMMU_DIR}/app
        ${VMMU_DIR}/bump
    )

    target_compile_definitions(app PRIVATE
        RAM_BASE_ADDR=0x20000000UL
        RAM_SIZE_BYTES=0x30000UL
        VMMU_NUM_FRAMES=8
        PERF_VMMU_BUILD
    )

    if(PERF_NO_TLB)
        message(STATUS "[perf_demo] TLB dezactivat (masuratoare naiva)")
        target_compile_definitions(app PRIVATE VMMU_DISABLE_TLB)
    endif()

    # malloc wrap routes app allocations through vmmu_malloc.
    # libc wraps route every memcpy/memset/strcpy/etc. through vmmu_check
    # before forwarding to picolibc — closes the libc bypass for app and
    # library code. Kernel IPC wraps (-Wl,--wrap=k_msgq_put ...) require
    # propagation into Zephyr's pre-link stage and remain future work.
    target_link_options(app PRIVATE
        -Wl,--wrap=malloc  -Wl,--wrap=free
        -Wl,--wrap=memcpy  -Wl,--wrap=memmove  -Wl,--wrap=memset
        -Wl,--wrap=memcmp
        -Wl,--wrap=strlen  -Wl,--wrap=strcpy   -Wl,--wrap=strncpy
        -Wl,--wrap=strcmp  -Wl,--wrap=strncmp
    )

    # workloads.c compiled with Clang + VMMUPass
    find_program(CLANG clang REQUIRED)
    set(WL_OBJ ${CMAKE_CURRENT_BINARY_DIR}/workloads.o)
    add_custom_command(
        OUTPUT  ${WL_OBJ}
        COMMAND ${CLANG}
                -target thumbv7em-none-eabi -mcpu=cortex-m4 -mthumb
                -mfloat-abi=soft -fshort-enums -O2 -g
                -ffunction-sections -fdata-sections
                -fpass-plugin=${PASS_SO}
                -I${CMAKE_CURRENT_SOURCE_DIR}/src
                -c ${CMAKE_CURRENT_SOURCE_DIR}/src/workloads.c
                -o ${WL_OBJ}
        DEPENDS src/workloads.c ${PASS_SO}
        COMMENT "Clang + VMMUPass: workloads.c"
    )

# ----------------------------------------------------------------
# Bare build
# ----------------------------------------------------------------
else()
    message(STATUS "[perf_demo] bare build — no VMMU")

    # Bare build uses plain k_malloc — needs a Zephyr heap pool
    set(EXTRA_CONF_FILE ${CMAKE_CURRENT_SOURCE_DIR}/bare.conf)

    target_sources(app PRIVATE src/bare_glue.c)

    # workloads.c compiled with plain Clang (no pass)
    find_program(CLANG clang REQUIRED)
    set(WL_OBJ ${CMAKE_CURRENT_BINARY_DIR}/workloads.o)
    add_custom_command(
        OUTPUT  ${WL_OBJ}
        COMMAND ${CLANG}
                -target thumbv7em-none-eabi -mcpu=cortex-m4 -mthumb
                -mfloat-abi=soft -fshort-enums -O2 -g
                -ffunction-sections -fdata-sections
                -I${CMAKE_CURRENT_SOURCE_DIR}/src
                -c ${CMAKE_CURRENT_SOURCE_DIR}/src/workloads.c
                -o ${WL_OBJ}
        DEPENDS src/workloads.c
        COMMENT "Clang (bare): workloads.c"
    )
endif()

add_custom_target(workloads_obj DEPENDS ${WL_OBJ})
target_sources(app PRIVATE ${WL_OBJ})
set_source_files_properties(${WL_OBJ} PROPERTIES EXTERNAL_OBJECT TRUE GENERATED TRUE)
add_dependencies(app workloads_obj)
```

## prj.conf
```kconfig
CONFIG_PRINTK=y
CONFIG_STDOUT_CONSOLE=y
CONFIG_UART_CONSOLE=y
CONFIG_SERIAL=y
CONFIG_MAIN_STACK_SIZE=8192
CONFIG_TIMING_FUNCTIONS=y
CONFIG_THREAD_CUSTOM_DATA=y
CONFIG_THREAD_STACK_INFO=y
CONFIG_THREAD_MONITOR=y
CONFIG_HEAP_MEM_POOL_SIZE=256
```

## boards/mps2_an386.conf
```kconfig
CONFIG_ARM_MPU=n
CONFIG_MPU=n
CONFIG_MPU_STACK_GUARD=n

# Force soft-float ABI so workloads.c (compiled by Clang with -mfloat-abi=soft)
# can link against Zephyr without a VFP register-arg mismatch.
CONFIG_FPU=n
```

## boards/nucleo_f429zi.conf
```kconfig
CONFIG_ARM_MPU=n
CONFIG_MPU=n
CONFIG_MPU_STACK_GUARD=n
```

## src/main.c
```c
#include "workloads.h"
#include <stdlib.h>
#include <zephyr/kernel.h>
#include <zephyr/sys/printk.h>
#include <zephyr/timing/timing.h>

void perf_setup(void);
const char *perf_label(void);

#define BUF_SIZE 512
#define ARRAY_ITERS 1000
#define XOR_ITERS 2000
#define RECURSIVE_DEPTH 48
#define RECURSIVE_ITERS 500
#define MATRIX_N 8
#define MATRIX_ITERS 200

#define PKT_COUNT 128
#define PKT_SIZE 32
#define FIR_SAMPLES 256
#define FIR_TAPS 16
#define FIR_ITERS 50
#define STREAM_LEN 256
#define STREAM_KEY_LEN 16
#define STREAM_ITERS 100

static void print_row(const char *name, uint64_t cycles)
{
    uint64_t ns = timing_cycles_to_ns(cycles);
    printk("[PERF] %-22s  cycles=%9llu   time=%7llu us\n",
           name,
           (unsigned long long)cycles,
           (unsigned long long)(ns / 1000U));
}

int main(void)
{
    perf_setup();

    printk("\n==============================================\n");
    printk("  %s\n", perf_label());
    printk("  Board: " CONFIG_BOARD "\n");
    printk("==============================================\n\n");

    uint8_t *buf = malloc(BUF_SIZE * 2);
    uint32_t *scratch = malloc((RECURSIVE_DEPTH + 1) * sizeof(uint32_t));
    int32_t *mat_a = malloc(MATRIX_N * MATRIX_N * sizeof(int32_t));
    int32_t *mat_b = malloc(MATRIX_N * sizeof(int32_t));
    int32_t *mat_out = malloc(MATRIX_N * sizeof(int32_t));

    uint8_t *pkt_in = malloc(PKT_COUNT * PKT_SIZE);
    uint8_t *pkt_out = malloc(PKT_COUNT * PKT_SIZE);
    int16_t *fir_in = malloc(FIR_SAMPLES * sizeof(int16_t));
    int16_t *fir_out = malloc(FIR_SAMPLES * sizeof(int16_t));
    int16_t *fir_coef = malloc(FIR_TAPS * sizeof(int16_t));
    uint8_t *xs_in = malloc(STREAM_LEN);
    uint8_t *xs_out = malloc(STREAM_LEN);
    uint8_t *xs_key = malloc(STREAM_KEY_LEN);

    if(!buf || !scratch || !mat_a || !mat_b || !mat_out ||
       !pkt_in || !pkt_out || !fir_in || !fir_out || !fir_coef ||
       !xs_in || !xs_out || !xs_key)
    {
        printk("[perf] allocation failed\n");
        return -1;
    }

    for(int i = 0; i < MATRIX_N * MATRIX_N; i++)
    {
        mat_a[i] = (int32_t)(i + 1);
    }
    for(int i = 0; i < MATRIX_N; i++)
    {
        mat_b[i] = (int32_t)(i + 1);
    }

    for(int i = 0; i < PKT_COUNT * PKT_SIZE; i++)
    {
        pkt_in[i] = (uint8_t)(i * 7);
    }
    for(int i = 0; i < FIR_SAMPLES; i++)
    {
        fir_in[i] = (int16_t)((i * 13) & 0x7FFF);
    }
    for(int i = 0; i < FIR_TAPS; i++)
    {
        fir_coef[i] = (int16_t)(i + 1);
    }
    for(int i = 0; i < STREAM_LEN; i++)
    {
        xs_in[i] = (uint8_t)(i * 11);
    }
    for(int i = 0; i < STREAM_KEY_LEN; i++)
    {
        xs_key[i] = (uint8_t)(i * 23);
    }

    timing_init();
    timing_start();

    timing_t t1, t2;
    uint64_t c_array, c_xor, c_rec, c_mat;
    uint64_t c_pkt, c_fir, c_xs;
    uint32_t d[4];
    uint32_t e[3];

    t1 = timing_counter_get();
    d[0] = wl_array_fill_sum(buf, BUF_SIZE, ARRAY_ITERS);
    t2 = timing_counter_get();
    c_array = timing_cycles_get(&t1, &t2);

    t1 = timing_counter_get();
    d[1] = wl_xor_sweep(buf + BUF_SIZE, BUF_SIZE, XOR_ITERS);
    t2 = timing_counter_get();
    c_xor = timing_cycles_get(&t1, &t2);

    t1 = timing_counter_get();
    d[2] = wl_recursive_sum(scratch, RECURSIVE_DEPTH, RECURSIVE_ITERS);
    t2 = timing_counter_get();
    c_rec = timing_cycles_get(&t1, &t2);

    t1 = timing_counter_get();
    d[3] = wl_matrix_dot(mat_a, mat_b, mat_out, MATRIX_N, MATRIX_ITERS);
    t2 = timing_counter_get();
    c_mat = timing_cycles_get(&t1, &t2);

    t1 = timing_counter_get();
    e[0] = wl_packet_io(pkt_in, pkt_out, PKT_COUNT, PKT_SIZE);
    t2 = timing_counter_get();
    c_pkt = timing_cycles_get(&t1, &t2);

    t1 = timing_counter_get();
    for(int it = 0; it < FIR_ITERS; it++)
    {
        e[1] = (uint32_t)wl_fir_filter(fir_in, fir_out, fir_coef,
                                       FIR_SAMPLES, FIR_TAPS);
    }
    t2 = timing_counter_get();
    c_fir = timing_cycles_get(&t1, &t2);

    t1 = timing_counter_get();
    e[2] = wl_stream_xor(xs_in, xs_out, xs_key,
                         STREAM_LEN, STREAM_KEY_LEN, STREAM_ITERS);
    t2 = timing_counter_get();
    c_xs = timing_cycles_get(&t1, &t2);

    timing_stop();

    free(buf);
    free(scratch);
    free(mat_a);
    free(mat_b);
    free(mat_out);
    free(pkt_in);
    free(pkt_out);
    free(fir_in);
    free(fir_out);
    free(fir_coef);
    free(xs_in);
    free(xs_out);
    free(xs_key);

    printk("\n");
    print_row("array_fill_sum", c_array);
    print_row("xor_sweep", c_xor);
    print_row("recursive_sum", c_rec);
    print_row("matrix_dot", c_mat);
    printk("\n");
    print_row("packet_io", c_pkt);
    print_row("fir_filter", c_fir);
    print_row("stream_xor", c_xs);
    printk("\n");
    print_row("TOTAL", c_array + c_xor + c_rec + c_mat +
                           c_pkt + c_fir + c_xs);
    printk("\n[PERF] checksum: %u %u %u %u | %u %u %u\n",
           d[0], d[1], d[2], d[3], e[0], e[1], e[2]);
#ifdef PERF_VMMU_BUILD
    extern uint32_t tlb_hits;
    printk("[PERF] tlb_hits = %u\n", (unsigned)tlb_hits);
#endif
    printk("==============================================\n\n");

    return 0;
}
```

## src/bare_glue.c
```c
#include <zephyr/kernel.h>

void perf_setup(void)
{
}

const char *perf_label(void)
{
    return "BARE  (no VMMU, no instrumentation)";
}
```

## src/vmmu_glue.c
```c
#include "app/app.h"
#include "translator.h"
#include "virtual_space/vpage.h"
#include "vmmu.h"
#include <zephyr/kernel.h>

#define HEAP_BASE (1u * PAGE_SIZE)
#define HEAP_LIMIT (8u * PAGE_SIZE)

void perf_setup(void)
{
    vmmu_init();
    app_subsystem_init();

    app_load(0, NULL, HEAP_BASE, HEAP_LIMIT);
    app *current_app = app_get(0);
    current_app->state = APP_RUNNING;
    k_thread_custom_data_set(current_app);
}

const char *perf_label(void)
{
    return "WITH VMMU  (VMMUPass + shadow memory)";
}

void *__wrap_malloc(size_t n)
{
    return vmmu_malloc(n);
}
void __wrap_free(void *p)
{
    vmmu_free(p);
}
```

## src/workloads.c
```c
#include <stdint.h>

uint32_t wl_array_fill_sum(uint8_t *buf, int n, int iters)
{
    uint32_t sum = 0;
    for(int i = 0; i < iters; i++)
    {
        for(int j = 0; j < n; j++)
        {
            buf[j] = (uint8_t)(i ^ j);
        }
        for(int j = 0; j < n; j++)
        {
            sum += buf[j];
        }
    }
    return sum;
}

uint32_t wl_xor_sweep(uint8_t *buf, int n, int iters)
{
    uint32_t acc = 0;
    for(int i = 0; i < iters; i++)
    {
        for(int j = 0; j < n; j++)
        {
            acc ^= buf[j];
        }
    }
    return acc;
}

static uint32_t rec_helper(uint32_t *scratch, int n)
{
    if(n <= 0)
    {
        return 0;
    }
    scratch[0] = (uint32_t)n;
    uint32_t child = rec_helper(scratch + 1, n - 1);
    return scratch[0] + child;
}

uint32_t wl_recursive_sum(uint32_t *scratch, int depth, int iters)
{
    uint32_t acc = 0;
    for(int i = 0; i < iters; i++)
    {
        acc += rec_helper(scratch, depth);
    }
    return acc;
}

uint32_t wl_matrix_dot(int32_t *a, int32_t *b, int32_t *out, int n, int iters)
{
    for(int k = 0; k < iters; k++)
    {
        for(int i = 0; i < n; i++)
        {
            int32_t sum = 0;
            for(int j = 0; j < n; j++)
            {
                sum += a[i * n + j] * b[j];
            }
            out[i] = sum;
        }
    }
    return (uint32_t)out[0];
}

uint32_t wl_packet_io(const uint8_t *in, uint8_t *out,
                      int n_packets, int pkt_size)
{
    uint32_t total = 0;
    for(int p = 0; p < n_packets; p++)
    {
        const uint8_t *src = in + p * pkt_size;
        uint8_t *dst = out + p * pkt_size;

        dst[0] = src[0];
        dst[1] = (uint8_t)(src[1] + 1);
        dst[2] = src[2];

        uint8_t cksum = 0;
        for(int i = 4; i < pkt_size; i++)
        {
            uint8_t v = (uint8_t)(src[i] ^ 0xA5);
            dst[i] = v;
            cksum ^= v;
        }
        dst[3] = cksum;
        total += cksum;
    }
    return total;
}

int32_t wl_fir_filter(const int16_t *input, int16_t *output,
                      const int16_t *coeffs, int n_samples, int n_taps)
{
    int32_t total = 0;
    for(int n = n_taps - 1; n < n_samples; n++)
    {
        int32_t acc = 0;
        for(int k = 0; k < n_taps; k++)
        {
            acc += (int32_t)input[n - k] * (int32_t)coeffs[k];
        }
        int16_t y = (int16_t)(acc >> 8);
        output[n] = y;
        total += y;
    }
    return total;
}

uint32_t wl_stream_xor(const uint8_t *in, uint8_t *out,
                       const uint8_t *key, int n, int key_size, int iters)
{
    uint32_t sum = 0;
    for(int it = 0; it < iters; it++)
    {
        for(int i = 0; i < n; i++)
        {
            uint8_t v = (uint8_t)(in[i] ^ key[i % key_size]);
            out[i] = v;
            sum += v;
        }
    }
    return sum;
}
```

## src/workloads.h
```c
#ifndef WORKLOADS_H
#define WORKLOADS_H
#include <stdint.h>

uint32_t wl_array_fill_sum(uint8_t *buf, int n, int iters);
uint32_t wl_xor_sweep(uint8_t *buf, int n, int iters);
uint32_t wl_recursive_sum(uint32_t *scratch, int depth, int iters);
uint32_t wl_matrix_dot(int32_t *a, int32_t *b, int32_t *out, int n, int iters);

uint32_t wl_packet_io(const uint8_t *in, uint8_t *out, int n_packets, int pkt_size);
int32_t wl_fir_filter(const int16_t *input, int16_t *output,
                      const int16_t *coeffs, int n_samples, int n_taps);
uint32_t wl_stream_xor(const uint8_t *in, uint8_t *out, const uint8_t *key,
                       int n, int key_size, int iters);

#endif
```
