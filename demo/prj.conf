## CMakeLists.txt
```
cmake_minimum_required(VERSION 3.20)
find_package(Zephyr REQUIRED HINTS $ENV{ZEPHYR_BASE})
project(vmmu_demo)

set(VMMU_DIR ${CMAKE_CURRENT_SOURCE_DIR}/../vmmu)

target_sources(app PRIVATE
    src/main.c
    src/demo_apps.c
    ${VMMU_DIR}/vmmu.c
    ${VMMU_DIR}/translator.c
    ${VMMU_DIR}/frame/frame.c
    ${VMMU_DIR}/virtual_space/addrspace.c
    ${VMMU_DIR}/virtual_space/vpage.c
    ${VMMU_DIR}/heap/heap.c
    ${VMMU_DIR}/app/app.c
    ${VMMU_DIR}/tlb.c
    ${VMMU_DIR}/boundary.c
    ${VMMU_DIR}/libc_wrap.c
    ${VMMU_DIR}/pass_defaults.c
)

# libc wraps: every memcpy / memset / strcpy / etc. in the binary
# (app code, libraries, even VMMU runtime self-calls) is routed through
# vmmu_check before forwarding to the real picolibc function. The
# relaxed bounds check in vmmu_check allows kernel-side SRAM accesses,
# so the wrap doesn't break the VMMU's own internal use of memset.
#
# Kernel IPC wraps (-Wl,--wrap=k_msgq_put etc.) are NOT enabled here:
# Zephyr's pre-link stage doesn't inherit target_link_options, so
# __real_k_msgq_put ends up undefined in that step. The libc wraps work
# because picolibc symbols don't appear in zephyr_pre0.elf.
target_link_options(app PRIVATE
    -Wl,--wrap=memcpy  -Wl,--wrap=memmove  -Wl,--wrap=memset
    -Wl,--wrap=memcmp
    -Wl,--wrap=strlen  -Wl,--wrap=strcpy   -Wl,--wrap=strncpy
    -Wl,--wrap=strcmp  -Wl,--wrap=strncmp
)

target_include_directories(app PRIVATE
    ${VMMU_DIR}
    ${VMMU_DIR}/frame
    ${VMMU_DIR}/virtual_space
    ${VMMU_DIR}/heap
    ${VMMU_DIR}/app
    ${VMMU_DIR}/bump
    ${CMAKE_CURRENT_SOURCE_DIR}/src
)

target_compile_definitions(app PRIVATE
    RAM_BASE_ADDR=0x20000000UL
    RAM_SIZE_BYTES=0x30000UL
    VMMU_NUM_FRAMES=16
)
```

## prj.conf
```kconfig
CONFIG_PRINTK=y
CONFIG_STDOUT_CONSOLE=y
CONFIG_MAIN_STACK_SIZE=4096
CONFIG_THREAD_CUSTOM_DATA=y
CONFIG_THREAD_STACK_INFO=y
CONFIG_THREAD_MONITOR=y
```

## boards/mps2_an386.conf
```kconfig
CONFIG_ARM_MPU=n
CONFIG_MPU=n
CONFIG_MPU_STACK_GUARD=n

# Keep soft-float to match the toolchain used elsewhere in the project.
CONFIG_FPU=n
```

## src/main.c
```c
#include <zephyr/kernel.h>
#include <zephyr/sys/printk.h>

#include "app/app.h"
#include "demo_apps.h"
#include "tlb.h"
#include "virtual_space/vpage.h"
#include "vmmu.h"

extern void boundary_init(void);

#define APP0_HEAP_BASE (1u * PAGE_SIZE)
#define APP0_HEAP_LIMIT (8u * PAGE_SIZE)
#define APP1_HEAP_BASE (8u * PAGE_SIZE)
#define APP1_HEAP_LIMIT (16u * PAGE_SIZE)
#define APP2_HEAP_BASE (1u * PAGE_SIZE)
#define APP2_HEAP_LIMIT (8u * PAGE_SIZE)

#define WATCHDOG_STACK_SIZE 512
#define WATCHDOG_PRIORITY 5

static void watchdog_fn(void *p1, void *p2, void *p3)
{
    ARG_UNUSED(p1);
    ARG_UNUSED(p2);
    ARG_UNUSED(p3);

    while(1)
    {
        printk("[watchdog] OS heartbeat — still running\n");
        k_msleep(10000);
    }
}

K_THREAD_DEFINE(watchdog_thread, WATCHDOG_STACK_SIZE,
                watchdog_fn, NULL, NULL, NULL,
                WATCHDOG_PRIORITY, 0, 0);

static void wait_for_app(app_id id)
{
    while(app_get(id)->state == APP_RUNNING)
    {
        k_msleep(100);
    }
}

static uint8_t results[14] = {0};

static void print_result(int demo_idx, app_id id,
                         app_state expected,
                         const char *label,
                         int extra_pass)
{
    app_state actual = app_get(id)->state;
    int pass = (actual == expected) && (extra_pass != 0);

    results[demo_idx] = pass ? 1 : 2;

    if(pass)
    {
        printk("[result] %-35s  PASS\n", label);
    }
    else
    {
        printk("[result] %-35s  FAIL\n", label);
        printk("[result]   expected state=%d  got state=%d  extra=%d\n",
               (int)expected, (int)actual, extra_pass);
    }
}

int main(void)
{
    printk("\n");
    printk("================================================\n");
    printk("  VMMU Demo — Software MMU on Zephyr/Cortex-M4\n");
    printk("================================================\n\n");

    vmmu_init();
    app_subsystem_init();
    boundary_init();

    k_msleep(500);

    printk("\n");
    printk("------------------------------------------------\n");
    printk("  Demo 1: Out-of-Bounds Write\n");
    printk("------------------------------------------------\n");
    printk("  App 0 writes to the guard page at heap_limit.\n");
    printk("  Expected: VMMU catches it, app 0 CRASHES, OS continues.\n\n");

    app_load(0, demo_oob_entry, APP0_HEAP_BASE, APP0_HEAP_LIMIT);
    app_start(0);
    wait_for_app(0);

    printk("\n");
    print_result(0, 0, APP_CRASHED,
                 "Demo 1: OOB write caught (app crashed)",
                 1);
    printk("[result]   OS status: watchdog still running\n");

    k_msleep(500);

    printk("\n");
    printk("------------------------------------------------\n");
    printk("  Demo 2: Cross-App Access\n");
    printk("------------------------------------------------\n");
    printk("  App 1 (victim) sleeps. App 0 reads app 1's address range.\n");
    printk("  Expected: app 0 CRASHES, app 1 and OS survive unharmed.\n\n");

    app_load(1, demo_victim_entry, APP1_HEAP_BASE, APP1_HEAP_LIMIT);
    app_start(1);

    app_load(0, demo_crossapp_entry, APP0_HEAP_BASE, APP0_HEAP_LIMIT);
    app_start(0);

    wait_for_app(0);

    int victim_alive = (app_get(1)->state == APP_RUNNING);

    printk("\n");
    print_result(1, 0, APP_CRASHED,
                 "Demo 2: cross-app access caught (app 0 crashed)",
                 victim_alive);
    printk("[result]   Victim app 1 still running: %s\n",
           victim_alive ? "YES" : "NO");

    app_stop(1);
    k_msleep(500);

    printk("\n");
    printk("------------------------------------------------\n");
    printk("  Demo 3: Demand Paging\n");
    printk("------------------------------------------------\n");
    printk("  App 0 accesses pages without malloc.\n");
    printk("  Expected: VMMU demand-allocates frames on first touch, NO crash.\n\n");

    app_load_bounded(0, demo_demand_entry, APP2_HEAP_BASE, APP2_HEAP_LIMIT,
                     UINT32_MAX);
    app_start(0);
    wait_for_app(0);

    printk("\n");
    print_result(2, 0, APP_STOPPED,
                 "Demo 3: demand paging succeeded (no crash)",
                 1);

    k_msleep(500);

    printk("\n");
    printk("------------------------------------------------\n");
    printk("  Demo 4: Sub-Page OOB via Shadow Memory\n");
    printk("------------------------------------------------\n");
    printk("  App 0 calls vmmu_malloc(20), then accesses buf+22.\n");
    printk("  Page is mapped — page check passes.\n");
    printk("  Shadow byte is SHADOW_UNOWNED — byte-granularity check catches it.\n");
    printk("  Expected: SHADOW FAULT, app 0 CRASHES, OS continues.\n\n");

    app_load(0, demo_subpage_oob_entry, APP2_HEAP_BASE, APP2_HEAP_LIMIT);
    app_start(0);
    wait_for_app(0);

    printk("\n");
    print_result(3, 0, APP_CRASHED,
                 "Demo 4: sub-page OOB caught (shadow fault)",
                 1);

    k_msleep(500);

    printk("\n");
    printk("------------------------------------------------\n");
    printk("  Demo 5: Stack Overflow\n");
    printk("------------------------------------------------\n");
    printk("  App 0 recurses infinitely with a 128-byte frame per call.\n");
    printk("  VMMUPass injects vmmu_stack_check() at every function entry.\n");
    printk("  Expected: STACK OVERFLOW caught, app 0 CRASHES, OS continues.\n\n");

    app_load(0, demo_stackoverflow_entry, APP2_HEAP_BASE, APP2_HEAP_LIMIT);
    app_start(0);
    wait_for_app(0);

    printk("\n");
    print_result(4, 0, APP_CRASHED,
                 "Demo 5: stack overflow caught (SP check)",
                 1);

    k_msleep(500);

    printk("\n");
    printk("------------------------------------------------\n");
    printk("  Demo 6: Global Variable Isolation\n");
    printk("------------------------------------------------\n");
    printk("  App has a mutable global — GlobalsPass places it in a frame.\n");
    printk("  VMMUPass redirects every access through the globals frame.\n");
    printk("  Access past frame end hits SHADOW_UNOWNED → SHADOW FAULT.\n");
    printk("  Without GlobalsPass: demo skips cleanly.\n\n");

    app_load(0, demo_globals_entry, APP2_HEAP_BASE, APP2_HEAP_LIMIT);
    app_start(0);
    wait_for_app(0);

    {
        app_state st = app_get(0)->state;
        int pass = (st == APP_CRASHED || st == APP_STOPPED);
        results[5] = pass ? 1 : 2;
    }

    printk("\n");
    if(app_get(0)->state == APP_CRASHED)
    {
        printk("[result] %-35s  PASS  (shadow fault caught OOB on globals frame)\n",
               "Demo 6: Global variable isolation");
    }
    else if(app_get(0)->state == APP_STOPPED)
    {
        printk("[result] %-35s  PASS  (GlobalsPass not active — skipped)\n",
               "Demo 6: Global variable isolation");
    }
    else
    {
        printk("[result] %-35s  FAIL\n",
               "Demo 6: Global variable isolation");
    }

    k_msleep(500);

    printk("\n");
    printk("------------------------------------------------\n");
    printk("  Demo 7: TLB Hit on Repeated Accesses\n");
    printk("------------------------------------------------\n");
    printk("  After vmmu_malloc, TLB entry covers entire allocation.\n");
    printk("  10 accesses inside the allocation — all should hit TLB.\n");
    printk("  Expected: tlb_hits=10, app STOPS normally.\n\n");

    app_load(0, demo_tlb_hit_entry, APP2_HEAP_BASE, APP2_HEAP_LIMIT);
    app_start(0);
    wait_for_app(0);

    {
        int pass = (app_get(0)->state == APP_STOPPED);
        results[6] = pass ? 1 : 2;
    }
    printk("\n");
    printk("[result] %-35s  %s\n", "Demo 7: TLB hit (10/10)",
           results[6] == 1 ? "PASS" : "FAIL");

    k_msleep(500);

    printk("\n");
    printk("------------------------------------------------\n");
    printk("  Demo 8: TLB Invalidated on Free\n");
    printk("------------------------------------------------\n");
    printk("  Access before free hits TLB.\n");
    printk("  After free: TLB entry removed, full check fires, UAF detected.\n");
    printk("  Expected: SHADOW FAULT, app CRASHES.\n\n");

    app_load(0, demo_tlb_uaf_entry, APP2_HEAP_BASE, APP2_HEAP_LIMIT);
    app_start(0);
    wait_for_app(0);

    printk("\n");
    print_result(7, 0, APP_CRASHED,
                 "Demo 8: TLB invalidated on free (UAF caught)", 1);

    k_msleep(500);

    printk("\n");
    printk("------------------------------------------------\n");
    printk("  Demo 9: TLB Range Covers Multi-Page Allocation\n");
    printk("------------------------------------------------\n");
    printk("  5000-byte allocation spans 2 pages.\n");
    printk("  Single TLB entry covers both pages — 4 accesses, 4 hits.\n");
    printk("  Expected: tlb_hits=4, app STOPS normally.\n\n");

    app_load(0, demo_tlb_range_entry, APP2_HEAP_BASE, APP2_HEAP_LIMIT);
    app_start(0);
    wait_for_app(0);

    {
        int pass = (app_get(0)->state == APP_STOPPED);
        results[8] = pass ? 1 : 2;
    }
    printk("\n");
    printk("[result] %-35s  %s\n", "Demo 9: TLB multi-page range",
           results[8] == 1 ? "PASS" : "FAIL");

    k_msleep(500);

    printk("\n");
    printk("------------------------------------------------\n");
    printk("  Demo 10: IPC valid case (boundary copy)\n");
    printk("------------------------------------------------\n");
    printk("  App calls vmmu_msgq_put with a properly allocated buffer.\n");
    printk("  copy_from_app validates the range, stages it, then k_msgq_put runs.\n");
    printk("  Expected: vmmu_msgq_put returns 0, app STOPS normally.\n\n");

    app_load(0, demo_ipc_valid_entry, APP2_HEAP_BASE, APP2_HEAP_LIMIT);
    app_start(0);
    wait_for_app(0);

    printk("\n");
    print_result(9, 0, APP_STOPPED,
                 "Demo 10: IPC valid (msg delivered)", 1);

    k_msleep(500);

    printk("\n");
    printk("------------------------------------------------\n");
    printk("  Demo 11: IPC invalid pointer (guard page)\n");
    printk("------------------------------------------------\n");
    printk("  App passes its guard page address to vmmu_msgq_put.\n");
    printk("  copy_from_app catches AS_ERR_PERM before kernel touches memory.\n");
    printk("  Expected: app CRASHES, OS continues.\n\n");

    app_load(0, demo_ipc_invalid_entry, APP2_HEAP_BASE, APP2_HEAP_LIMIT);
    app_start(0);
    wait_for_app(0);

    printk("\n");
    print_result(10, 0, APP_CRASHED,
                 "Demo 11: IPC invalid ptr blocked", 1);

    k_msleep(500);

    printk("\n");
    printk("------------------------------------------------\n");
    printk("  Demo 12: IPC cross-app pointer\n");
    printk("------------------------------------------------\n");
    printk("  App 0 passes app 1's address to vmmu_msgq_put.\n");
    printk("  copy_from_app uses app 0's vpage table → unmapped → abort.\n");
    printk("  Expected: app 0 CRASHES, app 1 stays RUNNING.\n\n");

    app_load(1, demo_victim_entry, APP1_HEAP_BASE, APP1_HEAP_LIMIT);
    app_start(1);

    app_load(0, demo_ipc_crossapp_entry, APP0_HEAP_BASE, APP0_HEAP_LIMIT);
    app_start(0);
    wait_for_app(0);

    int victim_alive_ipc = (app_get(1)->state == APP_RUNNING);
    printk("\n");
    print_result(11, 0, APP_CRASHED,
                 "Demo 12: IPC cross-app blocked", victim_alive_ipc);
    printk("[result]   Victim app 1 still running: %s\n",
           victim_alive_ipc ? "YES" : "NO");

    app_stop(1);
    k_msleep(500);

    printk("\n");
    printk("------------------------------------------------\n");
    printk("  Demo 13: Semaphore-gated virtual LED blink\n");
    printk("------------------------------------------------\n");
    printk("  Kernel thread releases a semaphore every 200 ms.\n");
    printk("  App thread waits on it, toggles a virtual LED (printk).\n");
    printk("  Expected: 10 alternating ON/OFF lines, app STOPS normally.\n\n");

    app_load(0, demo_semaphore_entry, APP2_HEAP_BASE, APP2_HEAP_LIMIT);
    app_start(0);
    wait_for_app(0);

    printk("\n");
    print_result(12, 0, APP_STOPPED,
                 "Demo 13: Semaphore LED blink", 1);

    k_msleep(500);

    printk("\n");
    printk("------------------------------------------------\n");
    printk("  Demo 14: TLB verification\n");
    printk("------------------------------------------------\n");
    printk("  100 accese repetate intr-o alocare -> toate lovesc TLB-ul.\n");
    printk("  Dupa free, intrarea este invalidata (lookup MISS).\n");
    printk("  Expected: tlb_hits=100, app STOPS normally.\n\n");

    app_load(0, demo_tlb_verify_entry, APP2_HEAP_BASE, APP2_HEAP_LIMIT);
    app_start(0);
    wait_for_app(0);

    printk("\n");
    print_result(13, 0, APP_STOPPED,
                 "Demo 14: TLB verification", 1);

    k_msleep(500);

    printk("\n");
    printk("================================================\n");
    printk("  TEST SUMMARY\n");
    printk("================================================\n");

    const char *demo_names[14] = {
        "Demo 1:  Out-of-Bounds Write     ",
        "Demo 2:  Cross-App Access        ",
        "Demo 3:  Demand Paging           ",
        "Demo 4:  Sub-Page OOB (Shadow)   ",
        "Demo 5:  Stack Overflow          ",
        "Demo 6:  Global Variable Isolation",
        "Demo 7:  TLB Hit (repeated access)",
        "Demo 8:  TLB Invalidated on Free ",
        "Demo 9:  TLB Multi-Page Range    ",
        "Demo 10: IPC valid (msg delivered)",
        "Demo 11: IPC invalid ptr blocked ",
        "Demo 12: IPC cross-app blocked   ",
        "Demo 13: Semaphore LED blink     ",
        "Demo 14: TLB verification        ",
    };

    int total_pass = 0;
    for(int i = 0; i < 14; i++)
    {
        const char *verdict = (results[i] == 1) ? "PASS" : "FAIL";
        if(results[i] == 1)
        {
            total_pass++;
        }
        printk("  %s  %s\n", demo_names[i], verdict);
    }

    printk("------------------------------------------------\n");
    printk("  Result: %d / 14 passed\n", total_pass);
    printk("================================================\n\n");

    return 0;
}
```

## src/demo_apps.c
```c
#include "demo_apps.h"
#include "app/app.h"
#include "boundary.h"
#include "tlb.h"
#include "translator.h"
#include "virtual_space/vpage.h"
#include "vmmu.h"

#include <stdint.h>
#include <zephyr/kernel.h>
#include <zephyr/sys/printk.h>

K_MSGQ_DEFINE(g_ipc_msgq, 32, 4, 4);

#define BLINK_COUNT 10
#define BLINK_PERIOD_MS 200
#define BLINK_STACK_SIZE 512

K_THREAD_STACK_DEFINE(g_blink_tick_stack, BLINK_STACK_SIZE);
static struct k_thread g_blink_tick_thread;
static struct k_sem g_blink_sem;

void demo_oob_entry(void *p1, void *p2, void *p3)
{
    app *current_app = app_current();

    printk("[demo] OOB: app %u running\n", (unsigned)current_app->id);

    void *buf = vmmu_malloc(64);
    if(!buf)
    {
        printk("[demo] OOB: vmmu_malloc failed\n");
        return;
    }

    printk("[demo] OOB: allocated buf at %p\n", buf);

    void *oob = (void *)current_app->heap_limit;
    printk("[demo] OOB: writing to guard page at %p — expect FAULT\n", oob);
    vmmu_check(oob, 4, PERM_WRITE);

    printk("[demo] OOB: ERROR — should not reach here\n");
}

void demo_victim_entry(void *p1, void *p2, void *p3)
{
    ARG_UNUSED(p1);
    ARG_UNUSED(p2);
    ARG_UNUSED(p3);

    app *current_app = app_current();
    printk("[demo] VICTIM: app %u alive — sleeping\n", (unsigned)current_app->id);

    while(1)
    {
        k_msleep(500);
    }
}

void demo_crossapp_entry(void *p1, void *p2, void *p3)
{
    app *current_app = app_current();

    printk("[demo] CROSS: app %u running\n", (unsigned)current_app->id);

    void *cross_ptr = (void *)(9u * PAGE_SIZE);
    printk("[demo] CROSS: reading from app 1's range at %p — expect FAULT\n",
           cross_ptr);
    vmmu_check(cross_ptr, 4, PERM_READ);

    printk("[demo] CROSS: ERROR — should not reach here\n");
}

void demo_demand_entry(void *p1, void *p2, void *p3)
{
    app *current_app = app_current();

    printk("[demo] DEMAND: app %u running (demand paging enabled)\n",
           (unsigned)current_app->id);

    void *ptr = (void *)current_app->heap_base;
    printk("[demo] DEMAND: accessing unallocated page at %p\n", ptr);
    vmmu_check(ptr, 4, PERM_WRITE);

    printk("[demo] DEMAND: demand fault handled — OS mapped the frame on first access\n");

    void *ptr2 = (void *)(current_app->heap_base + PAGE_SIZE);
    printk("[demo] DEMAND: accessing second unallocated page at %p\n", ptr2);
    vmmu_check(ptr2, 4, PERM_WRITE);

    printk("[demo] DEMAND: second demand fault handled — app %u exiting normally\n",
           (unsigned)current_app->id);
}

void demo_subpage_oob_entry(void *p1, void *p2, void *p3)
{
    ARG_UNUSED(p1);
    ARG_UNUSED(p2);
    ARG_UNUSED(p3);

    app *current_app = app_current();
    printk("[demo] SUBPAGE: app %u running\n", (unsigned)current_app->id);

    void *buf = vmmu_malloc(20);
    if(!buf)
    {
        printk("[demo] SUBPAGE: vmmu_malloc failed\n");
        return;
    }

    printk("[demo] SUBPAGE: allocated 20-byte buf at %p\n", buf);

    void *oob = (uint8_t *)buf + 22;
    printk("[demo] SUBPAGE: accessing buf+22 at %p — expect SHADOW FAULT\n", oob);
    vmmu_check(oob, 4, PERM_WRITE);

    printk("[demo] SUBPAGE: ERROR — should not reach here\n");
}

static volatile int g_demo_global = 0;

void demo_globals_entry(void *p1, void *p2, void *p3)
{
    ARG_UNUSED(p1);
    ARG_UNUSED(p2);
    ARG_UNUSED(p3);

    app *current_app = app_current();
    printk("[demo] GLOBALS: app %u running\n", (unsigned)current_app->id);

    if(__vmmu_globals_size == 0 || current_app->globals_frame == 0)
    {
        printk("[demo] GLOBALS: GlobalsPass not active — globals frame not allocated\n");
        printk("[demo] GLOBALS: build with -fpass-plugin=libGlobalsPass.so to enable\n");
        printk("[demo] GLOBALS: SKIP\n");
        return;
    }

    printk("[demo] GLOBALS: globals frame vaddr=0x%08x size=%u bytes\n",
           (unsigned)current_app->globals_frame, (unsigned)__vmmu_globals_size);

    g_demo_global = 42;
    printk("[demo] GLOBALS: g_demo_global = %d (expect 42)\n",
           (int)g_demo_global);

    void *frame_ptr = (void *)(uintptr_t)current_app->globals_frame;
    vmmu_check(frame_ptr, 4, PERM_READ);
    printk("[demo] GLOBALS: in-bounds shadow check on globals frame PASSED\n");

    void *oob = (uint8_t *)frame_ptr + __vmmu_globals_size;
    printk("[demo] GLOBALS: accessing past frame end at %p — expect SHADOW FAULT\n",
           oob);
    vmmu_check(oob, 4, PERM_WRITE);

    printk("[demo] GLOBALS: ERROR — should not reach here\n");
}

static void stack_recurse(int depth)
{
    volatile uint8_t frame[128];
    frame[0] = (uint8_t)depth;

    vmmu_stack_check();

    printk("[demo] STACKOVERFLOW: depth=%d sp consuming stack...\n", depth);
    stack_recurse(depth + 1);

    frame[1]++;
}

void demo_stackoverflow_entry(void *p1, void *p2, void *p3)
{
    ARG_UNUSED(p1);
    ARG_UNUSED(p2);
    ARG_UNUSED(p3);

    app *current_app = app_current();
    printk("[demo] STACKOVERFLOW: app %u running — recursing until overflow\n",
           (unsigned)current_app->id);

    stack_recurse(0);

    printk("[demo] STACKOVERFLOW: ERROR — should not reach here\n");
}

void demo_tlb_hit_entry(void *p1, void *p2, void *p3)
{
    ARG_UNUSED(p1);
    ARG_UNUSED(p2);
    ARG_UNUSED(p3);

    app *current_app = app_current();
    printk("[demo] TLB-HIT: app %u running\n", (unsigned)current_app->id);

    void *buf = vmmu_malloc(64);
    if(!buf)
    {
        printk("[demo] TLB-HIT: vmmu_malloc failed\n");
        return;
    }
    printk("[demo] TLB-HIT: allocated 64 bytes at %p\n", buf);

    tlb_reset_stats();

    for(int i = 0; i < 10; i++)
    {
        vmmu_check((uint8_t *)buf + i, 1, PERM_READ);
    }

    printk("[demo] TLB-HIT: tlb_hits=%u (expect 10)\n",
           (unsigned)tlb_hits);

    vmmu_free(buf);
}

void demo_tlb_uaf_entry(void *p1, void *p2, void *p3)
{
    ARG_UNUSED(p1);
    ARG_UNUSED(p2);
    ARG_UNUSED(p3);

    app *current_app = app_current();
    printk("[demo] TLB-UAF: app %u running\n", (unsigned)current_app->id);

    void *buf = vmmu_malloc(64);
    if(!buf)
    {
        printk("[demo] TLB-UAF: vmmu_malloc failed\n");
        return;
    }

    tlb_reset_stats();

    vmmu_check(buf, 1, PERM_READ);
    printk("[demo] TLB-UAF: hits before free = %u (expect 1)\n",
           (unsigned)tlb_hits);

    vmmu_free(buf);

    uint32_t hits_snapshot = tlb_hits;

    printk("[demo] TLB-UAF: accessing freed buffer — expect SHADOW FAULT\n");
    vmmu_check(buf, 1, PERM_READ);

    printk("[demo] TLB-UAF: hits after free = %u (should still be %u — no new hit)\n",
           (unsigned)tlb_hits, (unsigned)hits_snapshot);
    printk("[demo] TLB-UAF: ERROR — should not reach here\n");
}

void demo_tlb_range_entry(void *p1, void *p2, void *p3)
{
    ARG_UNUSED(p1);
    ARG_UNUSED(p2);
    ARG_UNUSED(p3);

    app *current_app = app_current();
    printk("[demo] TLB-RANGE: app %u running\n", (unsigned)current_app->id);

    void *buf = vmmu_malloc(5000);
    if(!buf)
    {
        printk("[demo] TLB-RANGE: vmmu_malloc failed (need 2 frames)\n");
        return;
    }
    printk("[demo] TLB-RANGE: allocated 5000 bytes at %p (spans 2 pages)\n",
           buf);

    tlb_reset_stats();

    vmmu_check((uint8_t *)buf + 0, 1, PERM_READ);
    vmmu_check((uint8_t *)buf + 4095, 1, PERM_READ);
    vmmu_check((uint8_t *)buf + 4096, 1, PERM_READ);
    vmmu_check((uint8_t *)buf + 4999, 1, PERM_READ);

    printk("[demo] TLB-RANGE: tlb_hits=%u (expect 4 — both pages covered)\n",
           (unsigned)tlb_hits);

    vmmu_free(buf);
}

void demo_ipc_valid_entry(void *p1, void *p2, void *p3)
{
    ARG_UNUSED(p1);
    ARG_UNUSED(p2);
    ARG_UNUSED(p3);

    app *current_app = app_current();
    printk("[demo] IPC-VALID: app %u running\n", (unsigned)current_app->id);

    uint8_t *msg = vmmu_malloc(32);
    if(!msg)
    {
        printk("[demo] IPC-VALID: vmmu_malloc failed\n");
        return;
    }
    for(int i = 0; i < 32; i++)
    {
        msg[i] = (uint8_t)i;
    }

    int r = vmmu_msgq_put(&g_ipc_msgq,
                          (vpointer)(uintptr_t)msg,
                          K_NO_WAIT);
    printk("[demo] IPC-VALID: vmmu_msgq_put returned %d (expect 0)\n", r);

    k_msgq_purge(&g_ipc_msgq);

    vmmu_free(msg);
    printk("[demo] IPC-VALID: app %u exiting normally\n", (unsigned)current_app->id);
}

void demo_ipc_invalid_entry(void *p1, void *p2, void *p3)
{
    ARG_UNUSED(p1);
    ARG_UNUSED(p2);
    ARG_UNUSED(p3);

    app *current_app = app_current();
    printk("[demo] IPC-INVALID: app %u running\n", (unsigned)current_app->id);

    vpointer bad = (vpointer)current_app->heap_limit;
    printk("[demo] IPC-INVALID: sending guard page %p — expect FAULT\n",
           (void *)bad);
    vmmu_msgq_put(&g_ipc_msgq, bad, K_NO_WAIT);

    printk("[demo] IPC-INVALID: ERROR — should not reach here\n");
}

void demo_ipc_crossapp_entry(void *p1, void *p2, void *p3)
{
    ARG_UNUSED(p1);
    ARG_UNUSED(p2);
    ARG_UNUSED(p3);

    app *current_app = app_current();
    printk("[demo] IPC-CROSS: app %u running\n", (unsigned)current_app->id);

    vpointer cross = (vpointer)(9u * PAGE_SIZE);
    printk("[demo] IPC-CROSS: sending app 1's address %p — expect FAULT\n",
           (void *)cross);
    vmmu_msgq_put(&g_ipc_msgq, cross, K_NO_WAIT);

    printk("[demo] IPC-CROSS: ERROR — should not reach here\n");
}

static void blink_tick_fn(void *p1, void *p2, void *p3)
{
    ARG_UNUSED(p1);
    ARG_UNUSED(p2);
    ARG_UNUSED(p3);

    for(int i = 0; i < BLINK_COUNT; i++)
    {
        k_msleep(BLINK_PERIOD_MS);
        k_sem_give(&g_blink_sem);
    }
}

void demo_semaphore_entry(void *p1, void *p2, void *p3)
{
    ARG_UNUSED(p1);
    ARG_UNUSED(p2);
    ARG_UNUSED(p3);

    app *current_app = app_current();
    printk("[demo] SEM: app %u running — virtual LED blinker\n",
           (unsigned)current_app->id);

    k_sem_init(&g_blink_sem, 0, 1);

    k_thread_create(&g_blink_tick_thread,
                    g_blink_tick_stack,
                    BLINK_STACK_SIZE,
                    blink_tick_fn,
                    NULL, NULL, NULL,
                    5, 0, K_NO_WAIT);

    int led_state = 0;
    for(int i = 0; i < BLINK_COUNT; i++)
    {
        k_sem_take(&g_blink_sem, K_FOREVER);
        led_state ^= 1;
        printk("[demo] SEM: [tick %2d] LED %s\n",
               i + 1, led_state ? "ON " : "OFF");
    }

    printk("[demo] SEM: %d blinks completed — app %u exiting\n",
           BLINK_COUNT, (unsigned)current_app->id);
}

#define TLB_TEST_ACCESSES 100

void demo_tlb_verify_entry(void *p1, void *p2, void *p3)
{
    ARG_UNUSED(p1);
    ARG_UNUSED(p2);
    ARG_UNUSED(p3);

    app *current_app = app_current();
    printk("[demo] TLB-VERIFY: app %u running\n", (unsigned)current_app->id);

    void *buf = vmmu_malloc(256);
    if(!buf)
    {
        printk("[demo] TLB-VERIFY: vmmu_malloc failed\n");
        return;
    }

    tlb_reset_stats();
    for(int i = 0; i < TLB_TEST_ACCESSES; i++)
    {
        vmmu_check((uint8_t *)buf + (i % 256), 1, PERM_READ);
    }
    uint32_t hits_live = tlb_hits;
    printk("[demo] TLB-VERIFY: %d accese -> tlb_hits=%u (asteptat %d)\n",
           TLB_TEST_ACCESSES, (unsigned)hits_live, TLB_TEST_ACCESSES);

    vmmu_free(buf);

    int after_free = tlb_lookup((uint32_t)(uintptr_t)buf, 1, (uint8_t)current_app->id);
    printk("[demo] TLB-VERIFY: lookup dupa free = %s (asteptat MISS)\n",
           (after_free == 0) ? "HIT" : "MISS");

    printk("[demo] TLB-VERIFY: app %u exiting normally\n", (unsigned)current_app->id);
}
```

## src/demo_apps.h
```c
#ifndef DEMO_APPS_H
#define DEMO_APPS_H

void demo_oob_entry(void *p1, void *p2, void *p3);

void demo_victim_entry(void *p1, void *p2, void *p3);

void demo_crossapp_entry(void *p1, void *p2, void *p3);

void demo_demand_entry(void *p1, void *p2, void *p3);

void demo_subpage_oob_entry(void *p1, void *p2, void *p3);

void demo_stackoverflow_entry(void *p1, void *p2, void *p3);

void demo_globals_entry(void *p1, void *p2, void *p3);

void demo_tlb_hit_entry(void *p1, void *p2, void *p3);

void demo_tlb_uaf_entry(void *p1, void *p2, void *p3);

void demo_tlb_range_entry(void *p1, void *p2, void *p3);

void demo_ipc_valid_entry(void *p1, void *p2, void *p3);

void demo_ipc_invalid_entry(void *p1, void *p2, void *p3);

void demo_ipc_crossapp_entry(void *p1, void *p2, void *p3);

void demo_semaphore_entry(void *p1, void *p2, void *p3);

void demo_tlb_verify_entry(void *p1, void *p2, void *p3);

#endif
```
